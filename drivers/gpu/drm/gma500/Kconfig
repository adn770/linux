## drivers/gpu/drm/gma500/Kconfig
```kconfig
# SPDX-License-Identifier: GPL-2.0-only
config DRM_GMA500
	tristate "Intel GMA500/600/3600/3650 KMS Framebuffer"
	depends on DRM && PCI && X86 && HAS_IOPORT
	select DRM_CLIENT_SELECTION
	select DRM_KMS_HELPER
	select DRM_GEM_SHMEM_HELPER
	select DRM_SCHED
	select FB_IOMEM_HELPERS if DRM_FBDEV_EMULATION
	select I2C
	select I2C_ALGOBIT
	# GMA500 depends on ACPI_VIDEO when ACPI is enabled, just like i915
	select ACPI_VIDEO if ACPI
	select BACKLIGHT_CLASS_DEVICE if ACPI
	select INPUT if ACPI
	select X86_PLATFORM_DEVICES if ACPI
	select ACPI_WMI if ACPI
	help
	  Say yes for an experimental 2D KMS framebuffer driver for the
	  Intel GMA500 (Poulsbo), Intel GMA600 (Moorestown/Oak Trail) and
	  Intel GMA3600/3650 (Cedar Trail).

config DRM_GMA500_KUNIT_TEST
	bool "KUnit tests for the GMA3600 SGX firmware loader" if !KUNIT_ALL_TESTS
	depends on DRM_GMA500 && KUNIT
	default KUNIT_ALL_TESTS
	help
	  Unit tests for sgx_fw.c, the parser for the SGX545 firmware file
	  (sgx545_ukernel.fw). They run when gma500_gfx is loaded with KUnit
	  available. If unsure, say N.
```
