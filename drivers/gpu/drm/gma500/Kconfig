## drivers/gpu/drm/gma500/Kconfig
```kconfig
# SPDX-License-Identifier: GPL-2.0-only
config DRM_GMA500
	tristate "Intel GMA500/600/3600/3650 KMS Framebuffer"
	depends on DRM && PCI && X86 && HAS_IOPORT
	select DRM_CLIENT_SELECTION
	select DRM_KMS_HELPER
	select DRM_GEM_SHMEM_HELPER
	select DRM_SCHED
	select FB_IOMEM_HELPERS if DRM_FBDEV_EMULATION
	select I2C
	select I2C_ALGOBIT
	# GMA500 depends on ACPI_VIDEO when ACPI is enabled, just like i915
	select ACPI_VIDEO if ACPI
	select BACKLIGHT_CLASS_DEVICE if ACPI
	select INPUT if ACPI
	select X86_PLATFORM_DEVICES if ACPI
	select ACPI_WMI if ACPI
	help
	  Say yes for an experimental 2D KMS framebuffer driver for the
	  Intel GMA500 (Poulsbo), Intel GMA600 (Moorestown/Oak Trail) and
	  Intel GMA3600/3650 (Cedar Trail).

config DRM_GMA500_KUNIT_TEST
	bool "KUnit tests for the GMA3600 SGX545 support" if !KUNIT_ALL_TESTS
	depends on DRM_GMA500 && KUNIT
	depends on KUNIT=y || DRM_GMA500=m
	default KUNIT_ALL_TESTS
	help
	  Unit tests for gma500's SGX545 support (the code in sgxfive/),
	  such as the parser of the SGX545 firmware file. They are built
	  into gma500_gfx and run when it is loaded with KUnit available.

	  If unsure, say N.

config DRM_GMA500_SGXFIVE_DEBUG
	bool "Debug files for the GMA3600 SGX545 support"
	depends on DRM_GMA500 && DEBUG_FS
	select CRYPTO_LIB_SHA256
	help
	  Extra debugfs files in dri/N/sgx/ for work on the SGX545 firmware
	  interface, such as a snapshot of every register the firmware uses
	  (dri/N/sgx/regs). They expose hardware and firmware state the
	  driver does not need, for development only. Their KUnit tests are
	  built only with this option.

	  If unsure, say N.
```
